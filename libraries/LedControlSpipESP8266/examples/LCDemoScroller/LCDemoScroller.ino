//We always have to include the library
#include <SPI.h>
#include "LedControlSPIESP8266.h"

/* needs at least a 8X8 dot matrix! Up to 8 can be cascaded*/
/* Demo is startingto be nice with 5 cascaded LED displays */

/*
 Now we need a LedControl to work with.
 ***** These pin numbers will probably not work with your hardware *****
 Pinout sur NodeMCU 
 D5 = GPIO14 = Clk   is connected to CLK  [pin 13 on max7219]
 D7 = GPIO13 = MOSI  is connected to DATA in [pin 1 on max7219]
 D8 = GPIO15 = SS    is connected to LOAD [pin 12 on max7219]
 We have only a single MAX72XX.
 */

#define NUMLEDDEVICES 8  // number of attached led devices
#define SCROLLSPEED 95   // Scroll Speed from 0 > 100 
#include "LedControlSPIESP8266.h" //  include the the library
#define LEDCSPIN  15     // Chip select pin for MAX7219
LedControl lc=LedControl(LEDCSPIN,NUMLEDDEVICES); // 
int luminosity=8;        // Led luminosity (0>15)
const char allEvents[]={"                           ESP8266 Demo -8 X cascaded 8X8 LED matrix displays powered by Max7219 and driven with fast SPI (8Mhz)...               "};
int allEventsSize = 0;

// The character set courtesy of cosmicvoid.  It is rowwise
byte Font8x5[96*8] =
       {0x00, 0x00, 0x00, 0x00, 0x00, 0x00, 0x00, 0x00, // [space]
        0x02, 0x02, 0x02, 0x02, 0x02, 0x00, 0x02, 0x00, // !
        0x05, 0x05, 0x05, 0x00, 0x00, 0x00, 0x00, 0x00, // "
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        0x00, 0x00, 0x00, 0x00, 0x00, 0x00, 0x00, 0x00 // [DEL] = 7F
      };
byte lentbl_S[96] =
{
        // width of chars
        2, 2, 3, 5, 5, 5, 5, 2, 
        3, 3, 5, 5, 2, 5, 1, 5, 
        5, 4, 5, 5, 5, 5, 5, 5, 
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        5, 4, 4, 3, 2, 3, 0, 0 
};

 
void setup() {
  // Init 8X8 leds
  for (int i=0; i<NUMLEDDEVICES; i++) {
    lc.shutdown(i,false);  // turn off power saving, enables display
    lc.setIntensity(i,8);  // sets brightness (0~15 possible values)
    lc.clearDisplay(i);    // clear screen
    }
 allEventsSize = strlen (allEvents);
}

void loop() {
int i,j,k;
int curcharix = 0;       // Current char index on string
int curcharbit = 0;      // Current bit processed
int curcharixsave = 0;
int curcharbitsave = 0;
int curcharixsave2 = 0;
int curcharbitsave2 = 0;
char curchar;            // Current char processed

while (1) {
  for (int i=0; i<NUMLEDDEVICES; i++) {   
    // The MAX72XX is in power-saving mode on startup
    lc.shutdown(i,false);
    // Set the brightness to a medium values 
    lc.setIntensity(i,luminosity);
    // and clear the display 
    lc.clearDisplay(i);
    }
  
  curcharixsave2 = curcharix;
  curcharbitsave2 = curcharbit;

  // Loop through our 8 displays
  // depending of led matrix components, one of the following must be uncommented
  // if chars are swapped, use the other one....
//for (i=NUMLEDDEVICES-1; i>=0;i--) {
  for (i=0;i<=NUMLEDDEVICES;i++)  {
    // Set up rows on current  display
    for (j=0;j<8;j++) {      
      byte outputbyte = 0; 
      curchar = allEvents[curcharix];
      curcharixsave = curcharix;
      curcharbitsave = curcharbit;

      // Copy over data for 8 columns to current row and send it to current display
      for (k=7;k>=0;k--)  {
        // This byte is the bitmap of the current character for the current row
        byte currentcharbits = Font8x5[((curchar-32)*8)+j];
        if (currentcharbits & (1<<curcharbit)) {
          outputbyte |= (1<<k);
          }
        // advance the current character bit of current character
        curcharbit ++;

        // we are past the end of this character, so advance.
        if (curcharbit > lentbl_S[curchar-32]) {
          curcharbit = 0;
          curcharix += 1;          
          if (curcharix+1 > allEventsSize) {
            curcharix=0;
            }
          curchar = allEvents[curcharix];
          } // end we are past the end of this character, so advance.
        } // end Copy over data for 8 columns
   
        lc.setRow(i, j, outputbyte);
        
        // if this is not the last row, roll back advancement, if it is, leave the counters advanced.
        if (j != 7) {
          curcharix = curcharixsave;
          curcharbit = curcharbitsave;
          } // end if this is not the last row
        } // end Set up rows on current  display
      } // end Loop through our 8 displays
  
    curcharix = curcharixsave2;
    curcharbit = curcharbitsave2; 
    curchar = allEvents[curcharix];
 
    // advance the current character bit of current character
    curcharbit ++;

    if (curcharbit > lentbl_S[curchar-32]) // we are past the end of this character, so advance.
    {
      curcharbit = 0;
      curcharix += 1;
      if (curcharix+1 > allEventsSize) {
        curcharix=-1;
        }
      curchar = allEvents[curcharix];
    }
    delay(101-SCROLLSPEED);
  }
}